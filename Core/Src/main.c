/* USER CODE BEGIN Header */
/**
  ******************************************************************************
  * @file           : main.c
  * @brief          : Main program body
  ******************************************************************************
  * @attention
  *
  * Copyright (c) 2026 STMicroelectronics.
  * All rights reserved.
  *
  * This software is licensed under terms that can be found in the LICENSE file
  * in the root directory of this software component.
  * If no LICENSE file comes with this software, it is provided AS-IS.
  *
  ******************************************************************************
  */
/* USER CODE END Header */
/* Includes ------------------------------------------------------------------*/
#include "main.h" //Generated by CubeMX, and declares your peripheral handles and pin macros (OLED_RES_Pin, B1_Pin, etc.)
#include "oled.h"
#include "console.h"
/* Private includes ----------------------------------------------------------*/
/* USER CODE BEGIN Includes */
#include <string.h> //buffer handling and command parsing (strlen, strncpy, memset, strcmp)
#include <stdio.h> //used to format numbers into text before sending over UART or drawing on the OLED (snprinf)
#include "bme280.h" //Bosch's vendor-supplied platform-independent driver
#include "sensor.h"
#include "i2c_if.h"
/* USER CODE END Includes */

/* Private typedef -----------------------------------------------------------*/
/* USER CODE BEGIN PTD */

/* USER CODE END PTD */

/* Private define ------------------------------------------------------------*/
/* USER CODE BEGIN PD */

/* USER CODE END PD */

/* Private macro -------------------------------------------------------------*/
/* USER CODE BEGIN PM */

/* USER CODE END PM */

/* Private variables ---------------------------------------------------------*/
//ST HAL structures representing the configured peripherals
I2C_HandleTypeDef hi2c1;
SPI_HandleTypeDef hspi1;
UART_HandleTypeDef huart2;

/* USER CODE BEGIN PV */
//static struct bme280_dev bme280_device; //Holds calibration data, interface type, and function pointers to my glue code
//static uint8_t bme280_i2c_address = BME280_I2C_ADDR_PRIM; //0x76, SDO pin is tied low
static uint8_t bme280_initialized = 0;

static uint32_t last_sample_time_ms = 0;
static uint32_t sample_interval_ms = 1000;

static uint8_t sample_valid = 0;


#define UART_COMMAND_BUFFER_SIZE 64U //preprocessor macro, longest command is "stream off", U = unsigned int

static volatile uint16_t uart_command_index = 0;
static volatile uint8_t uart_command_ready = 0;

/* UART streaming state */
static uint8_t stream_enabled = 0U; //1 means periodic UART sensor output is enabled.0 means streaming is disabled.
static uint32_t last_stream_time_ms = 0U;//Time of the most recent streamed UART output.
static uint32_t stream_interval_ms = 1000U;//Print one stored sample every 1000 ms while streaming is enabled.


/*Controls how often the OLED is refreshed.The BME280 may still be sampled independently.*/
static uint32_t last_oled_update_ms = 0U;
static uint32_t oled_update_interval_ms = 1000U;
/* USER CODE END PV */

/* Private function prototypes -----------------------------------------------*/
void SystemClock_Config(void);
static void MX_GPIO_Init(void);
static void MX_I2C1_Init(void);
static void MX_USART2_UART_Init(void);
static void MX_SPI1_Init(void);
/* USER CODE BEGIN PFP */
/* USER CODE BEGIN PFP */

static void I2C_Scan(void);
static void BME280_ReadChipID(void);

static void UART_CommandProcess(void);

static void BME280_PrintStoredSample(void);
static void BME280_StreamingProcess(void);
static void PrintSystemStatus(void);
/* application-specific function prototypes */
static void OLED_DisplaySensorData(void);
static void OLED_Process(void);
//static means private, no other source code can call it accidentally

/* USER CODE END PFP */

/* Private user code ---------------------------------------------------------*/
/* USER CODE BEGIN 0 */

/* USER CODE END 0 */

/**
  * @brief  The application entry point.
  * @retval int
  */
int main(void)
{

  /* USER CODE BEGIN 1 */

  /* USER CODE END 1 */

  /* MCU Configuration--------------------------------------------------------*/


  /* USER CODE BEGIN Init */
 /* Reset of all peripherals, Initializes the Flash interface and the Systick. */
	  HAL_Init();

  /* USER CODE END Init */


  /* USER CODE BEGIN SysInit */
 /* Configure the system clock */
	   SystemClock_Config(); //The F303 runs up to 36 MHz; this setup uses the HSI and PLL to reach the system clock used by the project.


  /* Initialize all configured peripherals */
  MX_GPIO_Init();
  MX_I2C1_Init();
  MX_USART2_UART_Init();
  MX_SPI1_Init();
  /* USER CODE END SysInit */


  /* USER CODE BEGIN 2 */
  const char message[] =
      "\r\n"
      "STM32 UART test working\r\n"
      "BME280 project started\r\n";

  HAL_UART_Transmit(
      &huart2,
      (uint8_t *)message,
      strlen(message),
      HAL_MAX_DELAY
  );

  HAL_Delay(100);

  I2C_Scan();

  HAL_Delay(100);
  BME280_ReadChipID();

  HAL_Delay(100);

  if (Sensor_Init() == HAL_OK)
  {
      last_sample_time_ms = HAL_GetTick() - sample_interval_ms;
  }

  Console_Init();

  Console_Print(
      "\r\nUART command reception enabled.\r\n"
      "Type a command and press Enter.\r\n"
  );

  /*
   * Initialize the SPI OLED.
   */
  if (OLED_Init() == HAL_OK)
  {
	  Console_Print("OLED initialized successfully.\r\n");

      //OLED_FillTest(); //First visible OLED test. Turn every pixel on.

      //UART_Print("OLED fill test sent.\r\n");
  }
  else
  {
	  Console_Print("OLED initialization failed.\r\n");
  }  /* USER CODE END 2 */

  /* Infinite loop */
  /* USER CODE BEGIN WHILE */
  while (1)
  {
    /* USER CODE END WHILE */

    /* USER CODE BEGIN 3 */

	  Sensor_Process();
      // BME280_DebugPrintProcess();
      UART_CommandProcess(); //Prints stored samples periodically only when stream_enabled is set.

      BME280_StreamingProcess();
      OLED_Process(); //Refresh local OLED display once per second.
  }
  /* USER CODE END 3 */
}

/**
  * @brief System Clock Configuration
  * @retval None
  */
void SystemClock_Config(void)
{
  RCC_OscInitTypeDef RCC_OscInitStruct = {0};
  RCC_ClkInitTypeDef RCC_ClkInitStruct = {0};
  RCC_PeriphCLKInitTypeDef PeriphClkInit = {0};

  /** Initializes the RCC Oscillators according to the specified parameters
  * in the RCC_OscInitTypeDef structure.
  */
  RCC_OscInitStruct.OscillatorType = RCC_OSCILLATORTYPE_HSI;
  RCC_OscInitStruct.HSIState = RCC_HSI_ON;
  RCC_OscInitStruct.HSICalibrationValue = RCC_HSICALIBRATION_DEFAULT;
  RCC_OscInitStruct.PLL.PLLState = RCC_PLL_ON;
  RCC_OscInitStruct.PLL.PLLSource = RCC_PLLSOURCE_HSI;
  RCC_OscInitStruct.PLL.PLLMUL = RCC_PLL_MUL9;
  RCC_OscInitStruct.PLL.PREDIV = RCC_PREDIV_DIV1;
  if (HAL_RCC_OscConfig(&RCC_OscInitStruct) != HAL_OK)
  {
    Error_Handler();
  }

  /** Initializes the CPU, AHB and APB buses clocks
  */
  RCC_ClkInitStruct.ClockType = RCC_CLOCKTYPE_HCLK|RCC_CLOCKTYPE_SYSCLK
                              |RCC_CLOCKTYPE_PCLK1|RCC_CLOCKTYPE_PCLK2;
  RCC_ClkInitStruct.SYSCLKSource = RCC_SYSCLKSOURCE_PLLCLK;
  RCC_ClkInitStruct.AHBCLKDivider = RCC_SYSCLK_DIV1;
  RCC_ClkInitStruct.APB1CLKDivider = RCC_HCLK_DIV2;
  RCC_ClkInitStruct.APB2CLKDivider = RCC_HCLK_DIV1;

  if (HAL_RCC_ClockConfig(&RCC_ClkInitStruct, FLASH_LATENCY_2) != HAL_OK)
  {
    Error_Handler();
  }
  PeriphClkInit.PeriphClockSelection = RCC_PERIPHCLK_USART2|RCC_PERIPHCLK_I2C1;
  PeriphClkInit.Usart2ClockSelection = RCC_USART2CLKSOURCE_PCLK1;
  PeriphClkInit.I2c1ClockSelection = RCC_I2C1CLKSOURCE_HSI;
  if (HAL_RCCEx_PeriphCLKConfig(&PeriphClkInit) != HAL_OK)
  {
    Error_Handler();
  }
}

/**
  * @brief I2C1 Initialization Function
  * @param None
  * @retval None
  */
static void MX_I2C1_Init(void)
{

  /* USER CODE BEGIN I2C1_Init 0 */

  /* USER CODE END I2C1_Init 0 */

  /* USER CODE BEGIN I2C1_Init 1 */

  /* USER CODE END I2C1_Init 1 */
  hi2c1.Instance = I2C1;
  hi2c1.Init.Timing = 0x00201D2B;
  hi2c1.Init.OwnAddress1 = 0;
  hi2c1.Init.AddressingMode = I2C_ADDRESSINGMODE_7BIT;
  hi2c1.Init.DualAddressMode = I2C_DUALADDRESS_DISABLE;
  hi2c1.Init.OwnAddress2 = 0;
  hi2c1.Init.OwnAddress2Masks = I2C_OA2_NOMASK;
  hi2c1.Init.GeneralCallMode = I2C_GENERALCALL_DISABLE;
  hi2c1.Init.NoStretchMode = I2C_NOSTRETCH_DISABLE;
  if (HAL_I2C_Init(&hi2c1) != HAL_OK)
  {
    Error_Handler();
  }

  /** Configure Analogue filter
  */
  if (HAL_I2CEx_ConfigAnalogFilter(&hi2c1, I2C_ANALOGFILTER_ENABLE) != HAL_OK)
  {
    Error_Handler();
  }

  /** Configure Digital filter
  */
  if (HAL_I2CEx_ConfigDigitalFilter(&hi2c1, 0) != HAL_OK)
  {
    Error_Handler();
  }
  /* USER CODE BEGIN I2C1_Init 2 */

  /* USER CODE END I2C1_Init 2 */

}

/**
  * @brief SPI1 Initialization Function
  * @param None
  * @retval None
  */
static void MX_SPI1_Init(void)
{

  /* USER CODE BEGIN SPI1_Init 0 */

  /* USER CODE END SPI1_Init 0 */

  /* USER CODE BEGIN SPI1_Init 1 */

  /* USER CODE END SPI1_Init 1 */
  /* SPI1 parameter configuration*/
  hspi1.Instance = SPI1;
  hspi1.Init.Mode = SPI_MODE_MASTER;
  hspi1.Init.Direction = SPI_DIRECTION_2LINES;
  hspi1.Init.DataSize = SPI_DATASIZE_8BIT;
  hspi1.Init.CLKPolarity = SPI_POLARITY_LOW;
  hspi1.Init.CLKPhase = SPI_PHASE_1EDGE;
  hspi1.Init.NSS = SPI_NSS_SOFT;
  hspi1.Init.BaudRatePrescaler = SPI_BAUDRATEPRESCALER_32;
  hspi1.Init.FirstBit = SPI_FIRSTBIT_MSB;
  hspi1.Init.TIMode = SPI_TIMODE_DISABLE;
  hspi1.Init.CRCCalculation = SPI_CRCCALCULATION_DISABLE;
  hspi1.Init.CRCPolynomial = 7;
  hspi1.Init.CRCLength = SPI_CRC_LENGTH_DATASIZE;
  hspi1.Init.NSSPMode = SPI_NSS_PULSE_ENABLE;
  if (HAL_SPI_Init(&hspi1) != HAL_OK)
  {
    Error_Handler();
  }
  /* USER CODE BEGIN SPI1_Init 2 */

  /* USER CODE END SPI1_Init 2 */

}

/**
  * @brief USART2 Initialization Function
  * @param None
  * @retval None
  */
static void MX_USART2_UART_Init(void)
{

  /* USER CODE BEGIN USART2_Init 0 */

  /* USER CODE END USART2_Init 0 */

  /* USER CODE BEGIN USART2_Init 1 */

  /* USER CODE END USART2_Init 1 */
  huart2.Instance = USART2;
  huart2.Init.BaudRate = 115200;
  huart2.Init.WordLength = UART_WORDLENGTH_8B;
  huart2.Init.StopBits = UART_STOPBITS_1;
  huart2.Init.Parity = UART_PARITY_NONE;
  huart2.Init.Mode = UART_MODE_TX_RX;
  huart2.Init.HwFlowCtl = UART_HWCONTROL_NONE;
  huart2.Init.OverSampling = UART_OVERSAMPLING_16;
  huart2.Init.OneBitSampling = UART_ONE_BIT_SAMPLE_DISABLE;
  huart2.AdvancedInit.AdvFeatureInit = UART_ADVFEATURE_NO_INIT;
  if (HAL_UART_Init(&huart2) != HAL_OK)
  {
    Error_Handler();
  }
  /* USER CODE BEGIN USART2_Init 2 */

  /* USER CODE END USART2_Init 2 */

}

/**
  * @brief GPIO Initialization Function
  * @param None
  * @retval None
  */
static void MX_GPIO_Init(void)
{
  GPIO_InitTypeDef GPIO_InitStruct = {0};
  /* USER CODE BEGIN MX_GPIO_Init_1 */

  /* USER CODE END MX_GPIO_Init_1 */

  /* GPIO Ports Clock Enable */
  __HAL_RCC_GPIOC_CLK_ENABLE();
  __HAL_RCC_GPIOF_CLK_ENABLE();
  __HAL_RCC_GPIOA_CLK_ENABLE();
  __HAL_RCC_GPIOB_CLK_ENABLE();

  /*Configure GPIO pin Output Level */
  HAL_GPIO_WritePin(GPIOB, OLED_RES_Pin|OLED_DC_Pin|OLED_CS_Pin, GPIO_PIN_RESET);

  /*Configure GPIO pin : B1_Pin */
  GPIO_InitStruct.Pin = B1_Pin;
  GPIO_InitStruct.Mode = GPIO_MODE_IT_FALLING;
  GPIO_InitStruct.Pull = GPIO_NOPULL;
  HAL_GPIO_Init(B1_GPIO_Port, &GPIO_InitStruct);

  /*Configure GPIO pins : OLED_RES_Pin OLED_DC_Pin OLED_CS_Pin */
  GPIO_InitStruct.Pin = OLED_RES_Pin|OLED_DC_Pin|OLED_CS_Pin;
  GPIO_InitStruct.Mode = GPIO_MODE_OUTPUT_PP;
  GPIO_InitStruct.Pull = GPIO_NOPULL;
  GPIO_InitStruct.Speed = GPIO_SPEED_FREQ_LOW;
  HAL_GPIO_Init(GPIOB, &GPIO_InitStruct);

  /* USER CODE BEGIN MX_GPIO_Init_2 */

  /* USER CODE END MX_GPIO_Init_2 */
}

/* USER CODE BEGIN 4 */

static void I2C_Scan(void)
{
    char message[64];
    uint8_t devices_found = 0;

    Console_Print("\r\nStarting I2C scan...\r\n");

    for (uint16_t address = 1; address < 128; address++) //loop starts at 1 rather than address 0x00 as that's reserved General Call address
    {
        HAL_StatusTypeDef result;

        result = I2C_IF_IsDeviceReady(
            (uint8_t)address,
            3U,
            20U
        );
// 127 × 3 × 20 ms ≈ 7.6 seconds, slow loop, runs once at boot in the main()
        if (result == HAL_OK)
        {
            snprintf(
                message,
                sizeof(message),
                "Device found at address 0x%02X\r\n",
                address
            );

            Console_Print(message);
            devices_found++;
        }
    }

    if (devices_found == 0)
    {
    	Console_Print("No I2C devices found.\r\n");
    }
    else
    {
        snprintf(
            message,
            sizeof(message),
            "Scan complete. Devices found: %u\r\n",
            devices_found
        );

        Console_Print(message);
    }
}

static void BME280_ReadChipID(void)
{
	const uint8_t bme280_address = 0x76U;
	const uint8_t chip_id_register = 0xD0U; //id register is at 0xD0 and contains 0x60

    uint8_t chip_id = 0;
    char message[64];

    HAL_StatusTypeDef result;

//Talk to device 0x76, then read internal register 0xD0.
    result = I2C_IF_ReadRegister(
            bme280_address,
            chip_id_register,
            &chip_id,
            1U,
            100U // <- timeout ceiling, not a fixed delay
    ); //blocking function

    if (result == HAL_OK)
    {
        snprintf(
            message,
            sizeof(message),
            "BME280 chip ID: 0x%02X\r\n",
            chip_id
        );

        Console_Print(message);

        if (chip_id == 0x60U)
        {
        	Console_Print("Confirmed: BME280 detected.\r\n");
        }
        else
        {
        	Console_Print("Unexpected chip ID.\r\n");
        }
    }
    else
    {
    	Console_Print("Failed to read BME280 chip ID.\r\n");
    }
}






/**
 * @brief Processes one completed UART command.
 *
 * UART reception itself is interrupt-driven.
 * The interrupt collects characters and sets uart_command_ready
 * when the user presses Enter.
 *
 * The actual command processing happens here in the main loop.
 */
static void UART_CommandProcess(void)
{
    char local_command[CONSOLE_COMMAND_BUFFER_SIZE];
    const char *received_command;

    /*
     * No completed command waiting.
     */
    if (Console_CommandReady() == 0U)
    {
        return;
    }

    /*
     * Get the command that was assembled by console.c.
     */
    received_command = Console_GetCommand();

    /*
     * Copy it into a local buffer so main.c can safely process
     * the command even after the console buffer is cleared.
     */
    strncpy(
        local_command,
        received_command,
        sizeof(local_command)
    );

    /*
     * Guarantee a valid C string.
     */
    local_command[sizeof(local_command) - 1U] = '\0';

    /*
     * Tell console.c that this command has been consumed
     * so it can begin collecting the next command.
     */
    Console_ClearCommand();

    /*
     * Compare the received text with the supported commands.
     */
    if (strcmp(local_command, "help") == 0)
    {
        Console_Print(
            "\r\nAvailable commands:\r\n"
            "  help        - Show this command list\r\n"
            "  sensor      - Print the latest stored sensor reading\r\n"
            "  stream on   - Start periodic sensor output\r\n"
            "  stream off  - Stop periodic sensor output\r\n"
            "  status      - Show current application status\r\n"
        );
    }
    else if (strcmp(local_command, "sensor") == 0)
    {
        /*
         * Print the most recently stored BME280 measurement.
         * This does not trigger a new I2C measurement.
         */
        BME280_PrintStoredSample();
    }
    else if (strcmp(local_command, "stream on") == 0)
    {
        /*
         * Enable periodic UART reporting.
         * Sensor sampling is already running independently.
         */
        stream_enabled = 1U;

        /*
         * Make the first streamed value appear immediately.
         */
        last_stream_time_ms =
            HAL_GetTick() - stream_interval_ms;

        Console_Print(
            "\r\nSensor streaming enabled.\r\n"
        );
    }
    else if (strcmp(local_command, "stream off") == 0)
    {
        /*
         * Stop UART reporting only.
         * Sensor_Process() continues reading the sensor
         * at the configured sampling interval.
         */
        stream_enabled = 0U;

        Console_Print(
            "\r\nSensor streaming disabled.\r\n"
        );
    }
    else if (strcmp(local_command, "status") == 0)
    {
        PrintSystemStatus();
    }
    else
    {
        Console_Print("\r\nUnknown command: ");
        Console_Print(local_command);
        Console_Print(
            "\r\nType 'help' for available commands.\r\n"
        );
    }

    /*
     * Prompt for the next command.
     */
    Console_Print("> ");
}

static void BME280_PrintStoredSample(void)
{
    char message[160];
    SensorData data;

    /*
     * A sample is valid only after at least one successful sensor read.
     */
    if (Sensor_HasValidData() == 0U)
    {
    	Console_Print(
            "\r\nSensor reading is not available yet.\r\n"
        );

        return;
    }

    /*
     * Ask the sensor module for the latest values.
     */
    Sensor_GetLatestData(&data);

    /*
     * Convert the stored floating-point values into readable text.
     *
     * SensorData contains:
     * - temperature in degrees Celsius
     * - humidity in percent
     * - pressure in pascals
     *
     * Dividing pressure by 100 converts Pa to hPa.
     */
    snprintf(
        message,
        sizeof(message),
        "\r\n"
        "Temperature: %.2f C\r\n"
        "Humidity: %.2f %%\r\n"
        "Pressure: %.2f hPa\r\n",
        data.temperature,
        data.humidity,
        data.pressure / 100.0f
    );

    Console_Print(message);
}
/**
 * @brief Periodically prints the latest stored sensor reading.
 *
 * Sensor sampling and UART streaming are independent activities.
 *
 * Sampling continues every second even when streaming is disabled.
 * This function only controls periodic UART reporting.
 */

static void BME280_StreamingProcess(void)
{
    /*
     * Do nothing when streaming has not been enabled by the user.
     */
    if (stream_enabled == 0U)
    {
        return;
    }

    /*
     * Do not print until at least one valid measurement exists.
     */
    if (sample_valid == 0U)
    {
        return;
    }

    uint32_t current_time_ms = HAL_GetTick();

    /*
     * Return immediately until the streaming interval has elapsed.
     *
     * This avoids blocking the main loop with HAL_Delay().
     */
    if ((current_time_ms - last_stream_time_ms) < stream_interval_ms)
    {
        return;
    }

    /*
     * Record when this stream output occurred.
     */
    last_stream_time_ms = current_time_ms;

    /*
     * Print the most recently stored sample.
     */
    BME280_PrintStoredSample();
}

/**
 * @brief Prints the current application status.
 */
static void PrintSystemStatus(void)
{
    char message[256];

    const char *sensor_text;
    const char *sample_text;
    const char *stream_text;

    /*
     * Translate internal application state into
     * human-readable strings.
     */
    sensor_text =
        bme280_initialized ? "READY" : "NOT INITIALIZED";

    sample_text =
        sample_valid ? "YES" : "NO";

    stream_text =
        stream_enabled ? "ON" : "OFF";

    snprintf(
        message,
        sizeof(message),
        "\r\n"
        "System status:\r\n"
        "  Sensor: %s\r\n"
        "  Valid sample: %s\r\n"
        "  Sampling interval: %lu ms\r\n"
        "  Streaming: %s\r\n"
        "  Streaming interval: %lu ms\r\n",
        sensor_text,
        sample_text,
        (unsigned long)sample_interval_ms,
        stream_text,
        (unsigned long)stream_interval_ms
    );

    Console_Print(message);
}


/**
 * @brief Builds the environmental monitor screen
 *        using the latest stored BME280 measurement.
 */
static void OLED_DisplaySensorData(void)
{
    char line[24];
    SensorData data;

    /*
     * Don't display measurements until the sensor module
     * has produced at least one valid sample.
     */
    if (Sensor_HasValidData() == 0U)
    {
        OLED_Clear();

        OLED_DrawString(
            10,
            20,
            "NO SENSOR DATA"
        );

        OLED_UpdateScreen();

        return;
    }

    /*
     * Get the latest sensor values from the sensor module.
     */
    Sensor_GetLatestData(&data);

    /*
     * Start with a blank framebuffer.
     */
    OLED_Clear();

    /*
     * Screen title.
     */
    OLED_DrawString(
        25,
        2,
        "ENV MONITOR"
    );

    /*
     * Temperature.
     */
    snprintf(
        line,
        sizeof(line),
        "TEMP: %.1f C",
        data.temperature
    );

    OLED_DrawString(
        5,
        18,
        line
    );

    /*
     * Relative humidity.
     */
    snprintf(
        line,
        sizeof(line),
        "HUM: %.1f %%",
        data.humidity
    );

    OLED_DrawString(
        5,
        30,
        line
    );

    /*
     * Atmospheric pressure.
     * SensorData stores pressure in Pa.
     * Divide by 100 to display hPa.
     */
    snprintf(
        line,
        sizeof(line),
        "PRES: %.0f",
        data.pressure / 100.0f
    );

    OLED_DrawString(
        5,
        42,
        line
    );

    OLED_DrawString(
        80,
        42,
        "HPA"
    );

    /*
     * Push the completed framebuffer to the OLED.
     */
    OLED_UpdateScreen();
}


/**
 * @brief Periodically refreshes the OLED using HAL_GetTick().
 *
 * This follows the same non-blocking scheduling pattern
 * used elsewhere in the application.
 */
static void OLED_Process(void)
{
    uint32_t current_time_ms =
        HAL_GetTick();

    if ((current_time_ms - last_oled_update_ms)
        < oled_update_interval_ms)
    {
        return;
    }

    last_oled_update_ms =
        current_time_ms;

    OLED_DisplaySensorData();
}
/* USER CODE END 4 */

/**
  * @brief  This function is executed in case of error occurrence.
  * @retval None
  */
void Error_Handler(void)
{
  /* USER CODE BEGIN Error_Handler_Debug */
  /* User can add his own implementation to report the HAL error return state */
  __disable_irq();
  while (1)
  {
  }
  /* USER CODE END Error_Handler_Debug */
}
#ifdef USE_FULL_ASSERT
/**
  * @brief  Reports the name of the source file and the source line number
  *         where the assert_param error has occurred.
  * @param  file: pointer to the source file name
  * @param  line: assert_param error line source number
  * @retval None
  */
void assert_failed(uint8_t *file, uint32_t line)
{
  /* USER CODE BEGIN 6 */
  /* User can add his own implementation to report the file name and line number,
     ex: printf("Wrong parameters value: file %s on line %d\r\n", file, line) */
  /* USER CODE END 6 */
}
#endif /* USE_FULL_ASSERT */
